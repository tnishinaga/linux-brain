## arch/arm/mach-tmpa9xx/Kconfig
```kconfig
# SPDX-License-Identifier: GPL-2.0-only
# Based on MuCross TMPA9xx Linux 2.6.36.
# Copyright (C) 2010 Thomas Haase (Thomas.Haase@web.de)
config ARCH_TMPA9XX
	bool "Toshiba TMPA9xx"
	depends on ARCH_MULTI_V5
	select ARM_AMBA
	select ARM_VIC
	select TMPA9XX_TIMER
	help
	  Support for Toshiba TMPA9xx ARM926EJ-S processors.
```
